#include <SPI.h>
#include <Wire.h>
#include <Adafruit_GFX.h>
#include <Adafruit_SSD1306.h>
#define SCREEN_WIDTH 128
#define SCREEN_HEIGHT 64
#define OLED_RESET     8 // Reset pin # (or -1 if sharing Arduino reset pin)
Adafruit_SSD1306 display(SCREEN_WIDTH, SCREEN_HEIGHT, &Wire, OLED_RESET);

#define UP 2
#define DOWN 3
#define LEFT 4
#define RIGHT 5
#define FUNC1 6 //left function btn
int score=0;
int turn=0;
float s=2.5;
//bitmaps
const unsigned char car [] PROGMEM = {0x00, 0x00, 0x00, 0x00, 0x3f, 0xfc, 0x14, 0x28, 0x1f, 0xf8, 0x20, 0x04, 0x38, 0x9c, 0x21, 0x04, 0x3f, 0xfc, 0x10, 0x08, 0x10, 0x08};
const unsigned char explosion [] PROGMEM = {0x01, 0xf0, 0x00, 0x03, 0x18, 0x00, 0x26, 0x7f, 0x80, 0x79, 0xc3, 0xc0, 0xb1,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 0xa0, 0x00};
//21x32
const unsigned char tree0 [] PROGMEM = {0x03, 0xfc, 0x00, 0x07, 0xfe, 0x00, 0x0e, 0x7f, 0xe0, 0x3c, 0x00, 0x78, 0x30,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 0xfe, 0x00};
//19x29
const unsigned char tree1 [] PROGMEM = {0x07, 0xf8, 0x00, 0x07, 0xfc, 0x00, 0x0c, 0xff, 0x80, 0x38, 0x01, 0xe0, 0x30,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 0xfc, 0x00};
//17x27
const unsigned char tree2 [] PROGMEM = {0x0f, 0xf0, 0x00, 0x0f, 0xf8, 0x00, 0x09, 0xfe, 0x00, 0x30, 0x07, 0x80, 0x30,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 0xf8, 0x00};
//12x19
const unsigned char tree3 [] PROGMEM = {0x1f, 0x00, 0x37, 0xe0, 0x60, 0x70, 0x60, 0x30, 0xcb, 0xd0, 0x50, 0x10, 0x40,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 0x1f, 0x80};
int trees[100];
float v=0;
long z=0;
int tree=4;
#define a 13
#define starts 13
void setup() {
  Serial.begin(9600);
  if(!display.begin(SSD1306_SWITCHCAPVCC)) {
    Serial.println(F("SSD1306 allocation failed"));
    for(;;);
  }
  display.clearDisplay();
  pinMode(UP, INPUT);
  pinMode(LEFT, INPUT);
  pinMode(RIGHT, INPUT);
  pinMode(DOWN, INPUT);
  pinMode(FUNC1, INPUT);
  randomSeed(analogRead(A0));
  gen();
}
void loop() {
  display.clearDisplay();
  display.setCursor(0,0);
  display.setTextSize(1);
  display.setTextColor(WHITE);
  display.println("speed:"+String(int(v)));
  if(v>0.3){
    v-=0.1;
  }else{
    v=0;
  }
  z+=int(v);
  drawStreet();
  if(turn>150 || turn<-150){
    lose(0);
  }
  if(b(UP)){
    v+=2;
  }
  if(b(DOWN) && v>1.6){
    v-=1.5;
  }
  if(b(RIGHT)){
    turn+=2;
  }
  if(b(LEFT)){
    turn-=2;
  }
//  display.drawBitmap(int(x((z%a)+starts)+trees[tree]/6.4),(z%a)+starts,tree3,12,19,WHITE);
//  display.drawBitmap(int(x((z%a)+starts+a)+trees[tree+1]/4),(z%a)+starts+a,tree2,17,27,WHITE);
//  display.drawBitmap(int(x((z%a)+starts+a*2)+trees[tree+2]/3),(z%a)+starts+a*2,tree1,19,29,WHITE);
//  display.drawBitmap(int(x((z%a)+starts+a*3)+trees[tree+3]/2),(z%a)+starts+a*3,tree0,21,32,WHITE);
  display.drawBitmap(int(64+trees[tree-3]/6.4),(z%a)+starts,tree3,12,19,WHITE);
  display.drawBitmap(int(64+trees[tree-2]/4),(z%a)+starts+a,tree2,17,27,WHITE);
  display.drawBitmap(int(64+trees[tree-1]/3),(z%a)+starts+a*2,tree1,19,29,WHITE);
  display.drawBitmap(int(64+trees[tree]/2),(z%a)+starts+a*3,tree0,21,32,WHITE);
  display.drawBitmap(int(54+turn/8.5),52,car,16,11,WHITE);
  if(z%a<1 && v>0.3){
    tree++;
  }
  display.display();
}
void drawStreet(){
  for(int i=0; i<32; i++){
    display.drawLine(0,i+32,128,i+32,WHITE);
    if(turn>0){
      display.drawLine((turn/(i+s)+int(64-(i/1.5+11)))*1.5-32,i+32,(turn/(i+s)+int(64+(i/1.5+11)))*1.5-32,i+32,BLACK);
    }else{
      display.drawLine(int((-((-turn)/(i+s))+(64-(i/1.5+11)))*1.5)-32,i+32,int((-((-turn)/(i+s))+64+(i/1.5+11))*1.5)-32,i+32,BLACK);
    }
  }
}
bool b(int io){
  if(digitalRead(io)==HIGH){
    return true;
  }else{
    return false;
  }
}
void lose(int type){
  if(type==0){
    display.clearDisplay();
    display.fillRect(0,32,128,64,WHITE);
    display.setCursor(28,33);
    display.setTextSize(3);
    display.setTextColor(BLACK);
    display.println("LOSE");
    display.display();
    for(;;);
  }else{
    display.clearDisplay();
    display.drawBitmap(int(54+turn/8.5),52,car,16,11,WHITE);
    display.drawBitmap(52,34,explosion,20,29,WHITE);
    display.setCursor(28,16);
    display.setTextSize(3);
    display.setTextColor(WHITE);
    display.println("LOSE");
    display.display();
    for(;;);
  }
}
void gen(){
  for(int i=0; i<100; i++){
    trees[i]=random(-32,32);
  }
}
int x(int i){
  i=i-32;
  if(turn>0){
    return int((turn/(i+s)+int(64-(i/1.5+11)))*1.5-32);
  }else{
    return int((-((-turn)/(i+s))+(64-(i/1.5+11)))*1.5)-32;
  }
}
